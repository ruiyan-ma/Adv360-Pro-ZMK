macro_mission_ctrl: macro_mission_ctrl{
compatible = "zmk,behavior-macro";
label = "macro_mission_ctrl";
#binding-cells = <0>;
bindings = <&sk LCTRL>, <&kp UP>;
};
macro_right_desk: macro_right_desk{
compatible = "zmk,behavior-macro";
label = "macro_right_desk";
#binding-cells = <0>;
bindings = <&sk LCTRL>, <&kp RIGHT>;
};
macro_left_desk: macro_left_desk{
compatible = "zmk,behavior-macro";
label = "macro_left_desk";
#binding-cells = <0>;
bindings = <&sk LCTRL>, <&kp LEFT>;
};